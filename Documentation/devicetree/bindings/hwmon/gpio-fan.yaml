## Documentation/devicetree/bindings/hwmon/gpio-fan.yaml
```yaml
# SPDX-License-Identifier: (GPL-2.0-only OR BSD-2-Clause)
%YAML 1.2
---
$id: "http://devicetree.org/schemas/hwmon/gpio-fan.yaml#"
$schema: "http://devicetree.org/meta-schemas/core.yaml#"

title: Bindings for fan connected to GPIO lines

maintainers:
  - Simon Guinot <simon.guinot@sequanux.org>

description:
  Device cooling fans are not always controlled via a dedicated fan controller.
  In some setups, they can be always-on, or the speed could be controlled via a
  set of GPIO lines. Independent of the fan speed control, a fan's alarm output
  line could also be connected directly to a GPIO.

allOf:
  - $ref: "/schemas/thermal/thermal-cooling-devices.yaml#"

properties:
  compatible:
    const: gpio-fan

  gpios:
    description:
      Specifies the pins that map to bits in the control value, ordered
      MSB-->LSB.

  gpio-fan,speed-map:
    $ref: /schemas/types.yaml#/definitions/uint32-matrix
    description:
      A mapping of possible fan RPM speeds and the control value that should be
      set to achieve them. This array must have the RPM values in ascending
      order.
    items:
      items:
        - description: fan speed in RPM
        - description: GPIO group value

  alarm-gpios:
    description:
      This pin going active indicates something is wrong with the fan, and a
      udev event will be fired.

anyOf:
  - required:
      - compatible
      - alarm-gpios
  - required:
      - compatible
      - gpios

unevaluatedProperties: false

dependencies:
  gpio-fan,speed-map: [ gpios ]
  "#cooling-cells": [ "gpio-fan,speed-map" ]

examples:
  - |
      gpio_fan {
        compatible = "gpio-fan";
        gpios = <&gpio1 14 1>,
                <&gpio1 13 1>;
        gpio-fan,speed-map =  <0    0>,
                              <3000 1>,
                              <6000 2>;
        alarm-gpios = <&gpio1 15 1>;
      };
  - |
      gpio_fan_cool: gpio_fan {
          compatible = "gpio-fan";
          gpios = <&gpio2 14 1>,
                  <&gpio2 13 1>;
          gpio-fan,speed-map =  <0    0>,
                                <3000 1>,
                                <6000 2>;
          alarm-gpios = <&gpio2 15 1>;
          #cooling-cells = <2>; /* min followed by max */
      };
```
